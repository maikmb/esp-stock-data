## main/Kconfig.projbuild
```kconfig
menu "Stock Ticker Configuration"

    menu "WiFi"

        # SSID/password are intentionally NOT configurable here: networks are
        # picked from the on-screen WiFi panel (scan + password keyboard) and
        # persisted in NVS namespace "wifi_cfg".

        config ESP_MAXIMUM_RETRY
            int "Fast retry attempts before backoff"
            default 5
            help
                Number of quick reconnect attempts before the device switches
                to a slower retry interval. The device never gives up
                permanently -- it keeps retrying in the background so the
                screen recovers automatically once the AP is back.

    endmenu

    menu "Market Data API"

        config MARKET_ALPHA_VANTAGE_API_KEY
            string "Alpha Vantage API key"
            default ""
            help
                Free key from https://www.alphavantage.co/support/#api-key.
                Required for stock quotes (CONFIG_MARKET_STOCK_SYMBOLS).
                Crypto quotes via CoinGecko do not need a key.

        config MARKET_CRYPTO_IDS
            string "Default CoinGecko coin IDs (comma separated)"
            default "bitcoin,ethereum"
            help
                Factory-default crypto list, e.g. "bitcoin,ethereum,solana"
                (CoinGecko ids: https://api.coingecko.com/api/v3/coins/list).
                Only used until the list is edited on-screen (gear icon):
                after that the list lives in NVS and this value is ignored.

        config MARKET_STOCK_SYMBOLS
            string "Default stock ticker symbols (comma separated)"
            default "AAPL,MSFT"
            help
                Factory-default stock list for Alpha Vantage GLOBAL_QUOTE,
                e.g. "AAPL,MSFT,PETR4.SAO". Like the crypto ids, ignored once
                the user edits the ticker list on-screen (stored in NVS).

        config MARKET_REFRESH_INTERVAL_SEC
            int "Refresh interval (seconds)"
            default 60
            range 15 3600
            help
                How often to re-fetch prices. Alpha Vantage's free tier is
                rate-limited (25 requests/day as of 2026), so keep this high
                if you track several stock symbols.

    endmenu

endmenu
```

## sdkconfig.defaults
```kconfig
CONFIG_ESP_WIFI_SOFTAP_SUPPORT=n

# ESP32-P4 has no native WiFi radio: run it over the onboard ESP32-C6 via
# esp-hosted (SDIO), using the espressif/esp_wifi_remote component pulled in
# by main/idf_component.yml.
CONFIG_ESP_WIFI_REMOTE_LIBRARY_HOSTED=y

# esp-hosted's SDIO transport allocates its buffer mempool from internal
# DMA-capable RAM by default, which is scarce enough on the P4 that it can
# fail to allocate even the ~47KB pool at boot (observed: hard crash in
# sdio_mempool_create before app_main ever runs, well before our own display
# init gets a chance -- looked like the display just never came up). The P4's
# GDMA can reach PSRAM through cache, so let the transport buffers live there
# instead and leave internal RAM free.
CONFIG_ESP_HOSTED_MEMPOOL_PREFER_SPIRAM=y

# The board has 16MB flash; without this esptool falls back to a 2MB
# assumption and logs a size-mismatch warning on every boot.
CONFIG_ESPTOOLPY_FLASHSIZE_16MB=y

# 32MB Hex-mode PSRAM (JC1060P470 module spec) -- needed for the LVGL
# display buffers and the WiFi/TLS stack's working memory.
CONFIG_SPIRAM=y
CONFIG_SPIRAM_MODE_HEX=y
CONFIG_SPIRAM_SPEED_200M=y

# HTTPS to CoinGecko / Alpha Vantage via the bundled CA certificates.
CONFIG_MBEDTLS_CERTIFICATE_BUNDLE=y
CONFIG_MBEDTLS_CERTIFICATE_BUNDLE_DEFAULT_FULL=y

# LVGL + esp_wifi_remote + mbedtls comfortably exceed the default small
# single-app partition.
CONFIG_PARTITION_TABLE_SINGLE_APP_LARGE=y

# Font sizes used by ui.c for the market cards.
CONFIG_LV_FONT_MONTSERRAT_20=y
CONFIG_LV_FONT_MONTSERRAT_28=y
# LVGL's builtin sprintf has %f disabled unless this is set (PRINTF_DISABLE_SUPPORT_FLOAT
# = !LV_USE_FLOAT in lv_sprintf_builtin.c) -- without it, lv_label_set_text_fmt("$%.2f", ...)
# silently prints the literal conversion char ("$f") instead of the number.
CONFIG_LV_USE_FLOAT=y
```
